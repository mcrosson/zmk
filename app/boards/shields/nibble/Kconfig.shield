## app/boards/shields/nibble/Kconfig.shield
```kconfig
# Copyright (c) 2021 The ZMK Contributors
# SPDX-License-Identifier: MIT

config SHIELD_NIBBLE
	def_bool $(shields_list_contains,nibble)

config SHIELD_NIBBLE_ISO
	def_bool $(shields_list_contains,nibble_iso)
```

## app/dts/bindings/behaviors/zmk,behavior-toggle-key.yaml
```yaml
# Copyright (c) 2020 The ZMK Contributors
# SPDX-License-Identifier: MIT

description: Toggle key behavior

compatible: "zmk,behavior-toggle-key"

include: one_param.yaml

properties:
  bindings:
    type: phandles
    required: true
```

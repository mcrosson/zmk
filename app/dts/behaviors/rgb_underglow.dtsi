/*
 * Copyright (c) 2020 The ZMK Contributors
 *
 * SPDX-License-Identifier: MIT
 */

/ {
	behaviors {
		rgb_ug: behavior_rgb_underglow {
			compatible = "zmk,behavior-rgb-underglow";
			label = "RGB_UNDERGLOW";
			#binding-cells = <2>;
			#activate-behavior-cells = <2>;
			#deactivate-behavior-cells = <2>;
		};
	};
};
